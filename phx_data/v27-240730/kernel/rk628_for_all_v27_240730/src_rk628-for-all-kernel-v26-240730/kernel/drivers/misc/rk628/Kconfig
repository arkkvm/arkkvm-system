## phx_data/v27-240730/kernel/rk628_for_all_v27_240730/src_rk628-for-all-kernel-v26-240730/kernel/drivers/misc/rk628/Kconfig
```kconfig
menu "RK628 misc driver"
config RK628_MISC
	bool "rk628 misc driver"
	default y
	help
	  Say y here to enable Rockchip rk628 support.
          This option is used to support rgb/hdmi/bt1120 input and dsi/lvds/gvi output
config RK628_MISC_HDMITX
	bool "rk628 misc hdmitx driver"
	default y
	depends on RK628_MISC
	depends on DRM
	depends on CEC_CORE
	help
	    Say y here to enable Rockchip rk628 misc hdmitx driver.
	    This option is used to support hdmi output.

config ROCKCHIP_THUNDER_BOOT_RK628
	bool "Rockchip RK628 Thunder Boot support"
	default y
	help
	  Say y here to enable Rockchip rk628 thunder boot support.
	  This option make the kernel boot faster.

endmenu
```
